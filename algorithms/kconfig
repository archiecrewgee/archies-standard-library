## kconfig
```kconfig
menu "Archie's Standard Library"

config CMAKE_TESTS_ENABLE
    bool "enable tests"
    select CMAKE_ALGORITHMS_ENABLE
    select CMAKE_MEMORY_ENABLE
    select CMAKE_MEMORY_IO_ENABLE

rsource "algorithms/kconfig"
rsource "memory/kconfig"
rsource "memory_io/kconfig"

endmenu
```

## memory/kconfig
```kconfig
config CMAKE_MEMORY_ENABLE
    bool 'enable memory' 
    select CMAKE_ALGORITHMS_ENABLE
```

## memory_io/kconfig
```kconfig
config CMAKE_MEMORY_IO_ENABLE
    bool 'enable memory io' 
    select CMAKE_MEMORY_ENABLE
```
